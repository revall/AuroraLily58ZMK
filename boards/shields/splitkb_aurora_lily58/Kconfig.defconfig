## boards/shields/splitkb_aurora_lily58/Kconfig.defconfig
```kconfig
if SHIELD_SPLITKB_AURORA_LILY58_DONGLE

config ZMK_KEYBOARD_NAME
	default "Aurora Lily58"

config ZMK_SPLIT_ROLE_CENTRAL
	default y

endif

if SHIELD_SPLITKB_AURORA_LILY58_DONGLE || SHIELD_SPLITKB_AURORA_LILY58_LEFT || SHIELD_SPLITKB_AURORA_LILY58_RIGHT

config ZMK_SPLIT
	default y
	
endif
```

## boards/shields/splitkb_aurora_lily58/kconfig.defconfig
```kconfig
if SHIELD_DONGLE

config ZMK_KEYBOARD_NAME
	default "Aurora Lily58"

config ZMK_SPLIT_ROLE_CENTRAL
	default y

endif

if SHIELD_DONGLE || SHIELD_SPLITKB_AURORA_LILY58_LEFT || SHIELD_SPLITKB_AURORA_LILY58_RIGHT

config ZMK_SPLIT
	default y
	
endif
```

## boards/shields/splitkb_aurora_lily58/kconfig.shield
```kconfig
config SHIELD_SPLITKB_AURORA_LILY58_DONGLE
	def_bool $(shields_list_contains,SPLITKB_AURORA_LILY58_dongle)

config SHIELD_SPLITKB_AURORA_LILY58_LEFT
	def_bool $(shields_list_contains,SPLITKB_AURORA_LILY58_left)

config SHIELD_SPLITKB_AURORA_LILY58_RIGHT
	def_bool $(shields_list_contains,SPLITKB_AURORA_LILY58_right)
```

## config/west.yml
```yaml
manifest:
  remotes:
    - name: zmkfirmware
      url-base: https://github.com/zmkfirmware
    - name: heyjva
      url-base: https://github.com/heyjva
    - name: petejohanson
      url-base: https://github.com/petejohanson
    # Additional modules containing boards/shields/custom code can be listed here as well
    # See https://docs.zephyrproject.org/3.2.0/develop/west/manifest.html#projects
  projects:
    - name: zmk-view-trackpad
      remote: heyjva
      revision: feat/pointers-move-scroll
      import: app/west.yml
    - name: cirque-input-module
      remote: cirque-input-module
      revision: main
  self:
    path: config
```
